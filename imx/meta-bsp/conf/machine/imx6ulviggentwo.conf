## imx/meta-bsp/conf/machine/imx6ulviggentwo.conf
```bitbake
#@TYPE: Machine
#@NAME: Bluewind i.MX6UL Viggen Two
#@SOC: i.MX6UL
#@DESCRIPTION: Machine configuration for Bluewind i.MX6UL Viggen Two
#@MAINTAINER: Alessandro Zappia <alessandro.zappia@bluewind.it>

include conf/machine/include/imx-base.inc
include conf/machine/include/tune-cortexa7.inc
include conf/machine/include/imx6ul-common.inc

SOC_FAMILY = "mx6ul"

KERNEL_DEVICETREE =  "imx6ul-viggentwo.dtb"

UBOOT_CONFIG ??= "emmc"
UBOOT_CONFIG[emmc] = "mx6ul_viggentwo_config,sdcard"
UBOOT_CONFIG[mfgtool] = "mx6ul_viggentwo_config"
```
